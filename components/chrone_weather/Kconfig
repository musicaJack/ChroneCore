## components/chrone_weather/Kconfig
```kconfig
menu "ChroneCore Weather (Seniverse)"

config CHRONECORE_WEATHER_CONFIG
    bool "Enable weather city list in WiFi provisioning page"
    default y
    help
        Enables /advanced/config city dropdown in the captive portal.

config CHRONECORE_WEATHER_API_KEY
    string "Seniverse API key"
    default ""
    help
        心知天气 API Key。留空则仅显示占位，不发起 HTTPS 请求。

config CHRONECORE_WEATHER_DEFAULT_CITY
    string "Default weather location id (pinyin)"
    default "beijing"
    depends on CHRONECORE_WEATHER_CONFIG
    help
        心知 location，如 beijing、kunming。须在城市白名单内。

endmenu
```

## sdkconfig.defaults
```kconfig
# ESP32 specific configuration
CONFIG_IDF_TARGET="esp32"

# Serial port configuration
CONFIG_ESPTOOLPY_FLASHMODE_QIO=y
CONFIG_ESPTOOLPY_FLASHFREQ_80M=y
CONFIG_ESPTOOLPY_FLASHSIZE_16MB=y

# Partition table configuration
CONFIG_PARTITION_TABLE_CUSTOM=y
CONFIG_PARTITION_TABLE_CUSTOM_FILENAME="partitions.csv"

# Log configuration
CONFIG_LOG_DEFAULT_LEVEL_INFO=y
CONFIG_LOG_MAXIMUM_LEVEL=5

# FreeRTOS configuration
CONFIG_FREERTOS_HZ=1000

# Memory configuration
# Enable PSRAM support for ESP32 with external PSRAM
CONFIG_SPIRAM=y
CONFIG_SPIRAM_USE_MALLOC=y
CONFIG_SPIRAM_ALLOW_BSS_SEG_EXTERNAL_MEMORY=y
CONFIG_SPIRAM_USE_CAPS_ALLOC=y
CONFIG_SPIRAM_TRY_ALLOCATE_WIFI_LWIP=y
CONFIG_SPIRAM_MALLOC_ALWAYSINTERNAL=0
CONFIG_SPIRAM_IGNORE_NOTFOUND=y
CONFIG_SPIRAM_BOOT_INIT=y
# Do not use MEMMAP on ESP32: it forces libc cache-workaround into IRAM and overflows with WiFi
# CONFIG_SPIRAM_USE_MEMMAP is not set
CONFIG_SPIRAM_TYPE_AUTO=y
# Note: ESP-IDF v5.x removed SPIRAM_SIZE_8M config option, PSRAM size is auto-detected
# CONFIG_SPIRAM_SIZE_8M=y  # Deprecated in ESP-IDF v5.x, no longer needed
CONFIG_SPIRAM_SPEED_80M=y
CONFIG_SPIRAM_MEMTEST=y

# Serial output configuration
CONFIG_ESP_CONSOLE_UART_DEFAULT=y
CONFIG_ESP_CONSOLE_UART_NUM=0
CONFIG_ESP_CONSOLE_UART_BAUDRATE=115200

# LVGL configuration - disable examples to avoid compilation errors
# CONFIG_LV_BUILD_EXAMPLES is not set
# CONFIG_LV_BUILD_DEMOS is not set

# C++ (chrone_app): no exceptions / RTTI
CONFIG_COMPILER_CXX_EXCEPTIONS=n

# LVGL fonts for clock UI
CONFIG_LV_FONT_MONTSERRAT_14=y
CONFIG_LV_FONT_MONTSERRAT_22=y

# Phase 3: WiFi / weather (set Seniverse API key in menuconfig)
CONFIG_CHRONECORE_WEATHER_CONFIG=y
CONFIG_CHRONECORE_WEATHER_DEFAULT_CITY="beijing"
CONFIG_CHRONECORE_WEATHER_API_KEY=""

# IRAM: WiFi stack + FreeRTOS in flash (saves ~10KB IRAM on ESP32)
CONFIG_FREERTOS_PLACE_FUNCTIONS_INTO_FLASH=y
# CONFIG_ESP_WIFI_IRAM_OPT is not set
# CONFIG_ESP_WIFI_RX_IRAM_OPT is not set
CONFIG_ESP_WIFI_STATIC_RX_BUFFER_NUM=3
CONFIG_ESP_WIFI_DYNAMIC_RX_BUFFER_NUM=6
```
